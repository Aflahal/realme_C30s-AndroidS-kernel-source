// SPDX-License-Identifier: (GPL-2.0+ OR MIT)
/*
 * Unisoc Sharkl3 platform L3  SOC DVFS DTS file
 *
 * Copyright (C) 2019, Unisoc Communications Inc.
 */

#include "sc9863a.dtsi"

/*
 *
 * Why: the 5.4 base dtb only has version-prefixed tables (operating-points-SC9863A-*),
 * and the version string comes from /hwfeature/auto, which does not exist here.
 * Without it the driver falls back to "operating-points-efuse bin>" and fails with -61.
 * These tables use exactly that fallback naming, with the board's own voltages.
 *
 */

&cpufreq_clus0 {

	operating-points = <
		/* kHz	uV */
		1200000 1121875
		1100000 1075000
		1000000 1028125
		884000	 975000
		768000	 918750>;
	operating-points-1 = <
		/* kHz	uV */
		1200000 1050000
		1100000 1006250
		1000000 959375
		884000	 903125
		768000	 900000>;
	operating-points-2 = <
		/* kHz	uV */
		1200000 1100000
		1100000 1056250
		1000000 1009375
		884000	 953125
		768000	 900000>;
	operating-points-3 = <
		/* kHz	uV */
		1200000 1150000
		1100000 1106250
		1000000 1059375
		884000	 1003125
		768000	 950000>;
	operating-points-1-65 = <
		/* kHz	uV */
		1200000 1071875
		1100000 1025000
		1000000 978125
		884000	 925000
		768000	 900000>;
	operating-points-2-65 = <
		/* kHz	uV */
		1200000 1121875
		1100000 1075000
		1000000 1028125
		884000	 975000
		768000	 918750>;
	operating-points-3-65 = <
		/* kHz	uV */
		1100000 1125000
		1000000 1078125
		884000	 1025000
		768000	 968750>;
};

&cpufreq_clus1 {

	operating-points = <
		/* kHz	uV */
		1600000	1121875
		1500000	1084375
		1400000	1050000
		1225000	984375
		1050000	921875
		768000	900000>;
	operating-points-1 = <
		/* kHz	uV */
		1600000	1050000
		1500000	1015625
		1400000	978125
		1225000	915625
		1050000	900000
		768000	900000>;
	operating-points-2 = <
		/* kHz	uV */
		1600000	1100000
		1500000	1065625
		1400000	1028125
		1225000	965625
		1050000	903125
		768000	900000>;
	operating-points-3 = <
		/* kHz	uV */
		1600000	1150000
		1500000	1115625
		1400000	1078125
		1225000	1015625
		1050000	953125
		768000	900000>;
	operating-points-1-65 = <
		/* kHz	uV */
		1600000	1071875
		1500000	1034375
		1400000	1000000
		1225000	934375
		1050000	900000
		768000	900000>;
	operating-points-2-65 = <
		/* kHz	uV */
		1600000	1121875
		1500000	1084375
		1400000	1050000
		1225000	984375
		1050000	921875
		768000	900000>;
	operating-points-3-65 = <
		/* kHz	uV */
		1500000	1134375
		1400000	1100000
		1225000	1034375
		1050000	971875
		768000	900000>;
};

&cpufreq_fcm {

	operating-points = <
		/* kHz	uV */
		1250000	1121875
		1172000	1084375
		1095000	1050000
		959000	984375
		824000	921875
		768000	900000>;
	operating-points-1 = <
		/* kHz	uV */
		1250000	1050000
		1172000	1015625
		1095000	978125
		959000	915625
		824000	900000
		768000	900000>;
	operating-points-2 = <
		/* kHz	uV */
		1250000	1100000
		1172000	1065625
		1095000	1028125
		959000	965625
		824000	903125
		768000	900000>;
	operating-points-3 = <
		/* kHz	uV */
		1250000	1150000
		1172000	1115625
		1095000	1078125
		959000	1015625
		824000	953125
		768000	925000>;
	operating-points-1-65 = <
		/* kHz	uV */
		1250000	1071875
		1172000	1034375
		1095000	1000000
		959000	934375
		824000	900000
		768000	900000>;
	operating-points-2-65 = <
		/* kHz	uV */
		1250000	1121875
		1172000	1084375
		1095000	1050000
		959000	984375
		824000	921875
		768000	918750>;
	operating-points-3-65 = <
		/* kHz	uV */
		1172000	1134375
		1095000	1100000
		959000	1034375
		824000	971875
		768000	968750>;
};
